/*
 * Copyright (c) 2020 The ZMK Contributors
 *
 * SPDX-License-Identifier: MIT
 */

#include <behaviors.dtsi>
#include <dt-bindings/zmk/keys.h>
#include <dt-bindings/zmk/bt.h>
#include <dt-bindings/zmk/rgb.h>

// Default = Windows layer
// Lower, 1 = macOS
// Raise, 2 = alternate and function

/ {
    keymap {
        compatible = "zmk,keymap";

//
// Windows Mode
// ,-----------------------------------------.                    ,---------------------------------------------.
// | Esc  |   1  |   2  |   3  |   4  |   5  |                    |   6  |   7  |   8  |   9  |   0  |  Bspc    |
// |------+------+------+------+------+------|                    |------+------+------+------+------+----------|
// | Tab  |   Q  |   W  |   E  |   R  |   T  |                    |   Y  |   U  |   I  |   O  |   P  |   \      |
// |------+------+------+------+------+------|                    |------+------+------+------+------+----------|
// |LShift|   A  |   S  |   D  |   F  |   G  |-------.    ,-------|   H  |   J  |   K  |   L  |   ;  |   '      |
// |------+------+------+------+------+------| Next  |    | Stop  |------+------+------+------+------+----------|
// | LCTR |   Z  |   X  |   C  |   V  |   B  |-------|    |-------|   N  |   M  |   ,  |   .  |   /  |  Win + L |
// `-----------------------------------------/       /     \      \---------------------------------------------'
//            |TO(1) | LAlt | MO(1)| LGUI | /  Del  /       \Enter \  |Space |   =  |  [   |   ]  |
//            |      |      |      |      |/       /         \      \ |      |      |      |      |
//            `----------------------------------'            '------''---------------------------'
//
            bindings = <
&kp ESC   &kp N1 &kp N2   &kp N3   &kp N4  &kp N5   &kp N6     &kp N7    &kp N8     &kp N9   &kp N0    &kp  BSPC
&kp TAB   &kp Q  &kp W    &kp E    &kp R   &kp T    &kp Y      &kp U     &kp I      &kp O    &kp P     &kp  BSLH
&kp LSHFT &kp A  &kp S    &kp D    &kp F   &kp G    &kp H      &kp J     &kp K      &kp L    &kp SEMI  &kp  SQT
&kp LCTRL &kp Z  &kp X    &kp C    &kp V   &kp B    &kp N      &kp M     &kp COMMA  &kp DOT  &kp FSLH  &kp  RSHFT
                 &to 1    &kp LALT &mo 2   &kp LGUI &kp DEL    &kp RET  &kp SPACE   &kp EQUAL &kp LBRC  &kp RBRC
            >;

            sensor-bindings = <&inc_dec_kp C_VOL_UP C_VOL_DN &inc_dec_kp PG_UP PG_DN>;
        };

        lower_layer {
//
// macOS mode
// ,-----------------------------------------.                    ,----------------------------------------------.
// | Esc  |   1  |   2  |   3  |   4  |   5  |                    |   6  |   7  |   8  |   9  |   0  |  Bspc     |
// |------+------+------+------+------+------|                    |------+------+------+------+------+-----------|
// | Tab  |   Q  |   W  |   E  |   R  |   T  |                    |   Y  |   U  |   I  |   O  |   P  |   \       |
// |------+------+------+------+------+------|                    |------+------+------+------+------+-----------|
// |LShift|   A  |   S  |   D  |   F  |   G  |-------.    ,-------|   H  |   J  |   K  |   L  |   ;  |   '       |
// |------+------+------+------+------+------| Next  |    | Stop  |------+------+------+------+------+-----------|
// | LCTR |   Z  |   X  |   C  |   V  |   B  |-------|    |-------|   N  |   M  |   ,  |   .  |   /  | Ctl+Cmd+Q |
// `-----------------------------------------/       /     \      \----------------------------------------------'
//            |TO(1) | LAlt | MO(1)| LGUI | /  Del  /       \Enter \  |Space |   =  |  [   |   ]  |
//            |      |      |      |      |/       /         \      \ |      |      |      |      |
//            `----------------------------------'            '------''---------------------------'
//
            bindings = <
&kp ESC   &kp N1 &kp N2   &kp N3   &kp N4  &kp N5   &kp N6     &kp N7    &kp N8     &kp N9   &kp N0    &kp  BSPC
&kp TAB   &kp Q  &kp W    &kp E    &kp R   &kp T    &kp Y      &kp U     &kp I      &kp O    &kp P     &kp  BSLH
&kp LSHFT &kp A  &kp S    &kp D    &kp F   &kp G    &kp H      &kp J     &kp K      &kp L    &kp SEMI  &kp  SQT
&kp LCTRL &kp Z  &kp X    &kp C    &kp V   &kp B    &kp N      &kp M     &kp COMMA  &kp DOT  &kp FSLH  &kp  RSHFT
                 &to 0    &kp LALT &mo 2   &kp LGUI &kp DEL    &kp RET  &kp SPACE   &kp EQUAL &kp LBRC  &kp RBRC
            >;

            sensor-bindings = <&inc_dec_kp C_VOL_UP C_VOL_DN &inc_dec_kp PG_UP PG_DN>;
        };

        raise_layer {
// Raise layer
// ,-----------------------------------------.                    ,-----------------------------------------.
// |      |  F1  |  F2  |  F3  |  F4  |  F5  |                    |  F6  |  F7  |  F8  |  F9  | F10  | F11  |
// |------+------+------+------+------+------|                    |------+------+------+------+------+------|
// |      |RGB_TOG|RGB_BRD|RGB_BRI|PgDwn| PgUp |                    | Home | End  |      |      |      | F12  |
// |------+------+------+------+------+------|                    |------+------+------+------+------+------|
// |EXTPWR|RGB_HUD|RGB_HUI|RGB_SAD|RGB_SAI|RGB_EFF|-------.    ,-------| Left | Down |  Up  |Right |      |      |
// |------+------+------+------+------+------|       |    |       |------+------+------+------+------+------|
// |BTCLR | BT1  | BT2  |  BT3 | BT4  |  BT5 |-------|    |-------|   -  |  `   |      |      |      |      |
// `-----------------------------------------/       /     \      \-----------------------------------------'
//            |      |      |      |      | /       /       \      \  |      |      |      |      |
//            |      |      |      |      |/       /         \      \ |      |      |      |       |
//            `----------------------------------'            '------''----------------------------'
//
            bindings = <
&trans     &kp F1          &kp F2          &kp F3          &kp F4          &kp F5          &kp F6    &kp F7    &kp F8 &kp F9    &kp F10 &kp F11
&trans     &trans          &trans          &trans          &kp PGDOWN      &kp PGUP        &kp HOME  &kp END   &trans &trans    &trans  &kp F12
&trans     &trans          &trans          &trans          &trans          &trans          &kp LEFT  &kp DOWN  &kp UP &kp RIGHT &trans  &trans
&trans     &trans          &trans          &trans          &trans          &trans          &kp MINUS &kp TILDE &trans &trans    &trans  &trans
                        &trans &trans &trans &trans &trans &trans &trans &trans &trans &trans
            >;

            sensor-bindings = <&inc_dec_kp C_VOL_UP C_VOL_DN &inc_dec_kp PG_UP PG_DN>;
        };
    };
};
